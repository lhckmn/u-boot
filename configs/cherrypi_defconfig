## configs/cherrypi_defconfig
```kconfig
CONFIG_ARM=y
CONFIG_ARCH_SUNXI=y
CONFIG_DEFAULT_DEVICE_TREE="sun8i-v3s-cherrypi"
CONFIG_SPL=y
CONFIG_MACH_SUN8I_V3S=y
CONFIG_DRAM_CLK=360
CONFIG_NO_NET=y


CONFIG_VIDEO=y
CONFIG_VIDEO_SUNXI=y
CONFIG_VIDEO_DE2=y

CONFIG_BACKLIGHT_GPIO=y

CONFIG_VIDEO_SIMPLE=y
CONFIG_VIDEO_DT_SIMPLEFB=y


#CONFIG_VIDEO=y
#CONFIG_VIDEO_SUNXI=y
#CONFIG_VIDEO_LCD_MODE="x:480,y:272,depth:18,pclk_khz:9000,le:43,ri:8,up:12,lo:8,hs:4,vs:4,sync:3,vmode:0"
#CONFIG_VIDEO_LCD_BL_EN="PB2"
#CONFIG_SYS_WHITE_ON_BLACK=y
#CONFIG_CONSOLE_MUX=y
#CONFIG_VIDEO_CONSOLE=y
#CONFIG_SPLASH_SCREEN=y
#CONFIG_SPLASH_SCREEN_ALIGN=y
#CONFIG_CMD_BMP=y
#CONFIG_CMD_CONSOLE=y
#CONFIG_OF_BOARD_SETUP=y






#CONFIG_VIDEO_LCD_DCLK_PHASE=0
#CONFIG_DM_REGULATOR=y
#CONFIG_BACKLIGHT_GPIO=y


#Logging
#CONFIG_LOG=y
#CONFIG_LOG_MAX_LEVEL=7
#CONFIG_LOG_DEFAULT_LEVEL=7
#CONFIG_LOG_CONSOLE=y
#CONFIG_LOGF_FUNC_PAD=20
```
